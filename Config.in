## configs/test_defconfig
```kconfig
# BR2_UCLIBC_INSTALL_UTILS is not set
BR2_INIT_NONE=y
BR2_SYSTEM_BIN_SH_NONE=y
# BR2_PACKAGE_BUSYBOX is not set
# BR2_PACKAGE_IFUPDOWN_SCRIPTS is not set
# BR2_TARGET_ROOTFS_TAR is not set
BR2_TESTFS=y
BR2_TESTFS_OPT=y
```

## package/testfs/Config.in
```kconfig
config BR2_TARGET_ROOTFS_TESTFS
	bool "super test fs"

if BR2_TARGET_ROOTFS_TESTFS

config BR2_TARGET_ROOTFS_TESTFS_OPT
	bool "super test fs option"

endif
```
